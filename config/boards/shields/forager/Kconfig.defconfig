## config/boards/shields/forager/Kconfig.defconfig
```kconfig
# Copyright (c) 2022 The ZMK Contributors
# SPDX-License-Identifier: MIT

if SHIELD_FORAGER_LEFT

config ZMK_KEYBOARD_NAME
    default "FORAGER"
    
config ZMK_SPLIT_ROLE_CENTRAL
    default y

endif

if SHIELD_FORAGER_LEFT || SHIELD_FORAGER_RIGHT

config ZMK_SPLIT
    default y

endif
```

## config/west.yml
```yaml
manifest:
  remotes:
    - name: zmkfirmware
      url-base: https://github.com/zmkfirmware
    # - name: carrefinho
    #   url-base: https://github.com/carrefinho
    - name: janpfischer
      url-base: https://github.com/janpfischer
    - name: urob
      url-base: https://github.com/urob
    - name: dhruvinsh
      url-base: https://github.com/dhruvinsh
    - name: JoMa388
      url-base: https://github.com/JoMa388
  projects:
    - name: zmk
      remote: zmkfirmware
      revision: v0.3
      import: app/west.yml
    - name: zmk-dongle-screen
      remote: janpfischer
      revision: v0.3
    - name: zmk-auto-layer
      remote: urob
      revision: v0.3
    - name: zmk-tri-state
      remote: dhruvinsh
      revision: main
    - name: zmk-adaptive-key
      remote: urob
      revision: v0.3
    - name: zmk-fork
      remote: JoMa388
      revision: v0.3
    - name: zmk-helpers
      remote: urob
      revision: v0.3
    - name: zmk-leader-key
      remote: urob
      revision: v0.3
  self:
    path: config
```
