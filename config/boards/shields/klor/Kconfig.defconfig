## config/boards/shields/klor/Kconfig.defconfig
```kconfig
# Copyright (c) 2022 The ZMK Contributors
# SPDX-License-Identifier: MIT

if SHIELD_KLOR_LEFT

config ZMK_KEYBOARD_NAME
    default "KLOR"

config ZMK_SPLIT_ROLE_CENTRAL
    default y

endif

if SHIELD_KLOR_LEFT || SHIELD_KLOR_RIGHT

config ZMK_SPLIT
    default y

if ZMK_DISPLAY

config I2C
    default y

config SSD1306
    default y

endif # ZMK_DISPLAY

endif
```
