#include <behaviors.dtsi>
#include <behaviors/num_word.dtsi> // urob's auto-layer repo
#include <dt-bindings/zmk/keys.h>
#include <dt-bindings/zmk/bt.h>
#include <dt-bindings/zmk/outputs.h>


#include "zmk-helpers/helper.h" // urob's helper repo
#include "zmk-helpers/key-labels/totem.h" // catpucciano key definiton


#define WIN   0
#define MAC   1
#define NUM   2 
#define FUNC  3
#define MOUSE 4
#define SYS   5
#define NAV   6

#define XXX &none
#define ___ &trans


#define QUICK_TAP_MS 175

&lt {
    flavor= "balanced";
    tapping-term-ms=<200>;
    quick-tap-ms=<175>;
};


/* Homerow mods */

#define KEYS_L LT0 LT1 LT2 LT3 LT4 LM0 LM1 LM2 LM3 LM4 LB0 LB1 LB2 LB3 LB4 LB5
#define KEYS_R RT0 RT1 RT2 RT3 RT4 RM0 RM1 RM2 RM3 RM4 RB0 RB1 RB2 RB3 RB4 RB5
#define THUMBS LH2 LH1 LH0 RH0 RH1 RH2 


#define MAKE_HRM(NAME, HOLD, TAP, TRIGGER_POS)                                 \
  ZMK_HOLD_TAP(NAME, bindings = <HOLD>, <TAP>; flavor = "balanced";            \
               tapping-term-ms = <280>; quick-tap-ms = <QUICK_TAP_MS>;         \
               require-prior-idle-ms = <150>; hold-trigger-on-release;         \
               hold-trigger-key-positions = <TRIGGER_POS>;)


MAKE_HRM(hml, &kp, &kp, KEYS_R THUMBS) // Left-hand HRMs.
MAKE_HRM(hmr, &kp, &kp, KEYS_L THUMBS) // Right-hand HRMs.


/* Combos, mouse emulation */
#include "includes/mouse.dtsi"
#include "includes/combos.dtsi"

// Trigger tap-action on all interrupts.
#define MT_CORE                                                                \
  flavor = "tap-preferred";                                                    \
  tapping-term-ms = <220>;                                                     \
  quick-tap-ms = <220>;                                                        \
  hold-trigger-key-positions = <0>;


&mt { MT_CORE };

/* Magic-shift & auto-layers */

// Tap: repeat after alpha, else sticky-shift |
// Shift + tap/ double-tap: caps-word | Hold: shift.

#define MAGIC_SHIFT &magic_shift LSHFT 0

ZMK_HOLD_TAP(magic_shift, bindings = <&kp>, <&magic_shift_tap>;
             flavor = "balanced"; tapping-term-ms = <200>;
             quick-tap-ms = <QUICK_TAP_MS>;)

ZMK_MOD_MORPH(magic_shift_tap, bindings = <&shift_repeat>, <&caps_word>;
              mods = <(MOD_LSFT)>;)

ZMK_ADAPTIVE_KEY(
    shift_repeat, bindings = <&sk LSHFT>;
    repeat {
      trigger-keys = <A B C D E F G H I J K L M N O P Q R S T U V W X Y Z>;
      bindings = <&key_repeat>;
      max-prior-idle-ms = <1200>;
      strict-modifiers;
    };)
&caps_word { // Mods deactivate caps-word, requires PR #1451. [TODO: rebase]
  /delete-property/ ignore-modifiers;
};

// Smart-mouse, requires tri-state module.
ZMK_TRI_STATE(
    smart_mouse, bindings = <&tog MOUSE>, <&none>, <&tog MOUSE>;
    ignored-key-positions =
        <LT1 LT2 LT3 LM0 LM1 LM2 LM3 LM4 LB1 LB2 LB3 LH1 LH2 RT3 >;
    ignored-layers = <MOUSE NAV>;)

// Alt+Tab swapper, requires tri-state module.
ZMK_TRI_STATE(swapper, bindings = <&kt LALT>, <&kp TAB>, <&kt LALT>;
              ignored-key-positions = <LT2 LT1>;)

// CTRL+Tab swapper, requires tri-state module.
ZMK_TRI_STATE(browse, bindings = <&kt LCTRL>, <&kp TAB>, <&kt LCTRL>;
              ignored-key-positions = <LT1 LT0>;)

// Define mod-morph with a *single* mod trigger for less repetition.
#define SIMPLE_MORPH(NAME, MOD, BINDING1, BINDING2)                            \
ZMK_MOD_MORPH(NAME, mods = <(MOD_L##MOD | MOD_R##MOD)>;                      \
                bindings = <BINDING1>, <BINDING2>;)
// Tap: comma | Shift + tap: semicolon.
SIMPLE_MORPH(comma_morph, SFT, &kp COMMA, &kp SEMI)

// Tap: dot | Shift + tap: colon.
SIMPLE_MORPH(dot_morph, SFT, &kp DOT, &kp COLON)

// Tap: qmark | Shift + tap: excl.
SIMPLE_MORPH(qexcl, SFT, &kp QMARK, &kp EXCL)

// Tap: fslh | Shift + tap: bslh.
SIMPLE_MORPH(fslh_bslh, SFT, &kp FSLH, &kp BSLH)

// Tap: left/right parenthesis | Shft + tap: less-than/greater-than.
SIMPLE_MORPH(lpar_lt, SFT, &kp LPAR, &kp LT)
SIMPLE_MORPH(rpar_gt, SFT, &kp RPAR, &kp GT)

ZMK_MACRO(tog_mac, 
    wait-ms = <100>;
    tap-ms  = <5>;
    bindings = <&to MAC &bt BT_SEL 1>;
)
ZMK_MACRO(tog_win, 
    wait-ms = <100>;
    tap-ms  = <5>;
    bindings = <&to WIN &bt BT_SEL 0>;
)

ZMK_MACRO(email,
    wait-ms = <20>;
    tap-ms  = <5>;
    bindings = <&kp J &kp O &kp N &kp A &kp T &kp H &kp A &kp N &kp M &kp A &kp N3 &kp N8 &kp N8 &kp AT &kp G &kp M &kp A &kp I &kp L &kp DOT &kp C &kp O &kp M>;
)

ZMK_MACRO(win_ble, 
    wait-ms = <100>;
    tap-ms  = <5>;
    bindings = <&kp LG(A) &kp RIGHT &kp TAB &kp ENTER>;
)

// MEH + NUM
#define MEH0     &kp LC(LS(LA(N0)))
#define MEH1     &kp LC(LS(LA(N1)))
#define MEH2     &kp LC(LS(LA(N2)))
#define MEH3     &kp LC(LS(LA(N3)))
#define MEH4     &kp LC(LS(LA(N4)))
#define MEH5     &kp LC(LS(LA(N5)))
#define MEH6     &kp LC(LS(LA(N6)))
#define MEH7     &kp LC(LS(LA(N7)))
#define MEH8     &kp LC(LS(LA(N8)))
#define MEH9     &kp LC(LS(LA(N9)))

// HYR + NUM
#define HYR0 &kp LC(LS(LA(LG(N0))))
#define HYR1 &kp LC(LS(LA(LG(N1))))
#define HYR2 &kp LC(LS(LA(LG(N2))))
#define HYR3 &kp LC(LS(LA(LG(N3))))
#define HYR4 &kp LC(LS(LA(LG(N4))))
#define HYR5 &kp LC(LS(LA(LG(N5))))
#define HYR6 &kp LC(LS(LA(LG(N6))))
#define HYR7 &kp LC(LS(LA(LG(N7))))
#define HYR8 &kp LC(LS(LA(LG(N8))))
#define HYR9 &kp LC(LS(LA(LG(N9))))

#define MEH_ENTER &mt LS(LC(LALT)) ENTER
#define HYR_ESC &mt LS(LC(LA(LGUI))) ESC

/* Keymap */                                    

#ifndef ZMK_BASE_LAYER
  #define ZMK_BASE_LAYER(name, LT, RT, LM, RM, LB, RB, LH, RH)                 \
      ZMK_LAYER(name, LT RT LM RM LB RB LH RH)
#endif
 
ZMK_BASE_LAYER(Win,
//               ╭──────────────┬──────────────┬──────────────┬──────────────┬──────────────╮  ╭──────────────┬──────────────┬──────────────┬──────────────┬──────────────╮
                   &kp PSCRN      &kp W          &kp L          &kp P          &kp B        ,    &kp Z          &kp J          &kp K          &kp SQT        &kp TAB      ,
               //├──────────────┼──────────────┼──────────────┼──────────────┼──────────────┤  ├──────────────┼──────────────┼──────────────┼──────────────┼──────────────┤
                   &hml LGUI C    &hml LALT S    &hml LCTRL N   &hml LSHFT T   &kp G        ,    &kp F          &hmr RSHFT A   &hmr RCTRL E   &hmr RALT I    &hmr RGUI H  ,
//╭──────────────┼──────────────┼──────────────┼──────────────┼──────────────┼──────────────┤  ├──────────────┼──────────────┼──────────────┼──────────────┼──────────────┼──────────────╮
     &kp DEL       &kp Q          &kp X          &kp M          &kp D          &kp V        ,    &comma_morph   &kp U          &kp O          &kp Y          &dot_morph     &kp C_MUTE   ,
//╰──────────────┴──────────────┴──────────────┼──────────────┼──────────────┼──────────────┤  ├──────────────┼──────────────┼──────────────┼──────────────┴──────────────┴──────────────╯
                                                 &kp ESC        &lt FUNC R     &lt NUM BSPC ,    &lt NAV SPACE  MAGIC_SHIFT    MEH_ENTER
//                                             ╰──────────────┴──────────────┴──────────────╯  ╰──────────────┴──────────────┴──────────────╯
)

ZMK_BASE_LAYER(Mac,
//               ╭──────────────┬──────────────┬──────────────┬──────────────┬──────────────╮  ╭──────────────┬──────────────┬──────────────┬──────────────┬──────────────╮
                   &kp PSCRN      &kp W          &kp L          &kp P          &kp B        ,    &kp Z          &kp J          &kp K          &kp SQT        &kp TAB      ,
               //├──────────────┼──────────────┼──────────────┼──────────────┼──────────────┤  ├──────────────┼──────────────┼──────────────┼──────────────┼──────────────┤
                   &hml LGUI C    &hml LALT S    &hml LCTRL N   &hml LSHFT T   &kp G        ,    &kp F          &hmr RSHFT A   &hmr RCTRL E   &hmr RALT I    &hmr RGUI H  ,
//╭──────────────┼──────────────┼──────────────┼──────────────┼──────────────┼──────────────┤  ├──────────────┼──────────────┼──────────────┼──────────────┼──────────────┼──────────────╮
     &kp DEL       &kp Q          &kp X          &kp M          &kp D          &kp V        ,    &comma_morph   &kp U          &kp O          &kp Y          &dot_morph     &kp C_MUTE   ,
//╰──────────────┴──────────────┴──────────────┼──────────────┼──────────────┼──────────────┤  ├──────────────┼──────────────┼──────────────┼──────────────┴──────────────┴──────────────╯
                                                 &kp ESC        &lt FUNC R     &lt NUM BSPC ,    &lt NAV SPACE  MAGIC_SHIFT    MEH_ENTER
//                                             ╰──────────────┴──────────────┴──────────────╯  ╰──────────────┴──────────────┴──────────────╯
)

ZMK_BASE_LAYER(Num,
//               ╭──────────────┬──────────────┬──────────────┬──────────────┬──────────────╮  ╭──────────────┬──────────────┬──────────────┬──────────────┬──────────────╮
                   ___            ___            &kp LS(TAB)    &swapper       &browse      ,    ___            &kp N7         &kp N8         &kp N9         ___          ,
               //├──────────────┼──────────────┼──────────────┼──────────────┼──────────────┤  ├──────────────┼──────────────┼──────────────┼──────────────┼──────────────┤
                   &hml LGUI N5   &hml LALT N4   &hml LCTRL N3  &hml LSHFT N2  &kp N1       ,    &kp K          &kp N4         &kp N5         &kp N6         ___          ,
//╭──────────────┼──────────────┼──────────────┼──────────────┼──────────────┼──────────────┤  ├──────────────┼──────────────┼──────────────┼──────────────┼──────────────┼──────────────╮
    &kp TAB        &kp N6         &kp N7         &kp N8         &kp N9         &kp N0       ,    &kp J          &kp N1         &kp N2         &kp N3         &dot_morph     ___          ,
//╰──────────────┴──────────────┴──────────────┼──────────────┼──────────────┼──────────────┤  ├──────────────┼──────────────┼──────────────┼──────────────┴──────────────┴──────────────╯
                                                 ___            ___            XXX          ,    &kp N0         &kp DLLR       ___
//                                             ╰──────────────┴──────────────┴──────────────╯  ╰──────────────┴──────────────┴──────────────╯
)

ZMK_BASE_LAYER(Func,
//               ╭──────────────┬──────────────┬──────────────┬──────────────┬──────────────╮  ╭──────────────┬──────────────┬──────────────┬──────────────┬──────────────╮
                   HYR1           HYR2           HYR3           HYR4           HYR5         ,    ___            ___            ___            ___             ___         ,
               //├──────────────┼──────────────┼──────────────┼──────────────┼──────────────┤  ├──────────────┼──────────────┼──────────────┼──────────────┼──────────────┤
                   MEH1           MEH2           MEH3           MEH4           MEH5         ,    &email         &win_ble       HYR3           HYR4           HYR5         ,
//╭──────────────┼──────────────┼──────────────┼──────────────┼──────────────┼──────────────┤  ├──────────────┼──────────────┼──────────────┼──────────────┼──────────────┼──────────────╮
    &trans         MEH6           MEH7           MEH8           MEH9           MEH0         ,    HYR6           HYR7           HYR8           HYR9           HYR0           ___          ,
//╰──────────────┴──────────────┴──────────────┼──────────────┼──────────────┼──────────────┤  ├──────────────┼──────────────┼──────────────┼──────────────┴──────────────┴──────────────╯
                                                 XXX            ___            ___          ,    ___            &mo SYS        ___
//                                             ╰──────────────┴──────────────┴──────────────╯  ╰──────────────┴──────────────┴──────────────╯
)

ZMK_BASE_LAYER(Mouse,
//               ╭──────────────┬──────────────┬──────────────┬──────────────┬──────────────╮  ╭──────────────┬──────────────┬──────────────┬──────────────┬──────────────╮
                   ___            ___            ___            ___            ___          ,    ___            ___            ___            ___            ___         ,
               //├──────────────┼──────────────┼──────────────┼──────────────┼──────────────┤  ├──────────────┼──────────────┼──────────────┼──────────────┼──────────────┤  
                   MS_SCRL        MS_LEFT        MS_UP          MS_RIGHT       MS_SCRR      ,    ___            ___            ___            ___            ___         ,
//╭──────────────┼──────────────┼──────────────┼──────────────┼──────────────┼──────────────┤  ├──────────────┼──────────────┼──────────────┼──────────────┼──────────────┼──────────────╮ 
    ___            ___            &mkp RCLK      MS_DOWN        &mkp LCLK      &mkp MCLK    ,    ___            ___            ___            ___            ___            ___         ,
//╰──────────────┴──────────────┴──────────────┼──────────────┼──────────────┼──────────────┤  ├──────────────┼──────────────┼──────────────┼──────────────┴──────────────┴──────────────╯
                                                 ___            MS_SCRD        MS_SCRU      ,    ___            ___            ___
//                                             ╰──────────────┴──────────────┴──────────────╯  ╰──────────────┴──────────────┴──────────────╯
)

ZMK_BASE_LAYER(Sys,
//               ╭──────────────┬──────────────┬──────────────┬──────────────┬──────────────╮  ╭──────────────┬──────────────┬──────────────┬──────────────┬──────────────╮
                   ___            ___            &bt BT_SEL 1   &bt BT_SEL 0   &bootloader  ,    &bootloader    ___            ___            ___            &bt BT_CLR   ,
               //├──────────────┼──────────────┼──────────────┼──────────────┼──────────────┤  ├──────────────┼──────────────┼──────────────┼──────────────┼──────────────┤  
                   &bt BT_SEL 3   &bt BT_SEL 2   &tog_mac       &tog_win       &out OUT_TOG ,    ___            ___            ___            ___            ___          ,
//╭──────────────┼──────────────┼──────────────┼──────────────┼──────────────┼──────────────┤  ├──────────────┼──────────────┼──────────────┼──────────────┼──────────────┼──────────────╮ 
    ___            ___            ___            ___            ___            ___          ,    ___            ___            ___            ___            ___            ___          ,
//╰──────────────┴──────────────┴──────────────┼──────────────┼──────────────┼──────────────┤  ├──────────────┼──────────────┼──────────────┼──────────────┴──────────────┴──────────────╯
                                                 ___            ___            XXX          ,    XXX            ___            ___
//                                             ╰──────────────┴──────────────┴──────────────╯  ╰──────────────┴──────────────┴──────────────╯
)

ZMK_BASE_LAYER(Nav,
//               ╭──────────────┬──────────────┬──────────────┬──────────────┬──────────────╮  ╭──────────────┬──────────────┬──────────────┬──────────────┬──────────────╮
                   &kp F12        &kp F7         &kp F8         &kp F9         ___          ,    XXX            &kp C_VOL_DN   &kp C_PP       &kp C_VOL_UP   ___          ,
               //├──────────────┼──────────────┼──────────────┼──────────────┼──────────────┤  ├──────────────┼──────────────┼──────────────┼──────────────┼──────────────┤
                   &kp F11        &kp F4         &kp F5         &kp F6         ___          ,    &kp LEFT       &kp DOWN       &kp UP         &kp RIGHT      &kp ENTER    ,
//╭──────────────┼──────────────┼──────────────┼──────────────┼──────────────┼──────────────┤  ├──────────────┼──────────────┼──────────────┼──────────────┼──────────────┼──────────────╮
    ___            &kp F10        &kp F1         &kp F2         &kp F3         ___          ,    &kp LT         &kp HOME       &kp END        &kp FSLH       ___            ___          ,
//╰──────────────┴──────────────┴──────────────┼──────────────┼──────────────┼──────────────┤  ├──────────────┼──────────────┼──────────────┼──────────────┴──────────────┴──────────────╯
                                                 ___            ___            &kp DEL      ,    XXX            ___            ___
//                                             ╰──────────────┴──────────────┴──────────────╯  ╰──────────────┴──────────────┴──────────────╯
)


